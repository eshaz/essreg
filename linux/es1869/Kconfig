## linux/es1869/Kconfig
```kconfig
# SPDX-License-Identifier: GPL-2.0-or-later
#
# The ES1869 driver. The defaults menu is generated by tools/es1869set.py
# from settings.def: change the rows there and run it again.

config SND_ES1869
	tristate "ESS ES1869 AudioDrive, every feature"
	depends on ISA_DMA_API
	select SND_OPL3_LIB
	select SND_MPU401_UART
	select SND_PCM
	select SND_HWDEP
	select SND_SEQ_DEVICE if SND_SEQUENCER != n
	help
	  Say Y or M for the ESS ES1869 AudioDrive with every feature of
	  the chip: both DACs (Audio 2 on a 16-bit DMA channel too), full
	  duplex, every rate of its clocks, the record mixer, the 3-D
	  effect, the DAC stages, the hardware volume buttons, the FM
	  recorded digitally, OPL3 and native ESFM synthesis, and the
	  MPU-401. Each setting is a module parameter that can be written
	  at runtime and, where it is chip state, an ALSA control.

	  It takes the same devices as snd-es18xx, so blacklist that one.

	  To compile this driver as a module, choose M here: the module
	  will be called snd-es1869.

config SND_ES1869_ESFM
	tristate "ES1869 native ESFM General MIDI synthesizer"
	depends on SND_ES1869 && SND_SEQUENCER
	default SND_ES1869
	help
	  A sequencer synthesizer on the ES1869's FM in its native ESFM
	  mode, playing General MIDI as ESS's fixed ESFM.DRV does, with a
	  bank loaded as firmware (es1869/esfm-gm.bin). The module will be
	  called snd-es1869-esfm.

menu "ES1869 default settings"
	depends on SND_ES1869

config SND_ES1869_DEFAULT_MASTER_VOLUME
	int "master_volume"
	range 0 63
	default 54
	help
	  Master volume (60h/62h bits 5:0), 63 = 0 dB, 0.75 dB a step.
	  The ALSA control "Master Playback Volume". The module
	  parameter master_volume sets it at load and at runtime,
	  through /sys/module/snd_es1869/parameters/master_volume.

config SND_ES1869_DEFAULT_MASTER_SWITCH
	int "master_switch"
	range 0 1
	default 1
	help
	  Master on (60h/62h bit 6 clear). The ALSA control "Master
	  Playback Switch". The module parameter master_switch sets it
	  at load and at runtime, through
	  /sys/module/snd_es1869/parameters/master_switch.

config SND_ES1869_DEFAULT_A2_VOLUME
	int "a2_volume"
	range 0 15
	default 15
	help
	  Audio 2's volume (7Ch), 15 = 0 dB. The ALSA control "PCM
	  Playback Volume". The module parameter a2_volume sets it at
	  load and at runtime, through
	  /sys/module/snd_es1869/parameters/a2_volume.

config SND_ES1869_DEFAULT_A1_VOLUME
	int "a1_volume"
	range 0 15
	default 14
	help
	  Audio 1's volume (14h), 14 = 0 dB. The ALSA control "PCM
	  Playback Volume". The module parameter a1_volume sets it at
	  load and at runtime, through
	  /sys/module/snd_es1869/parameters/a1_volume.

config SND_ES1869_DEFAULT_FM_VOLUME
	int "fm_volume"
	range 0 15
	default 8
	help
	  The music DAC's volume (36h), 8 = 0 dB. The ALSA control "FM
	  Playback Volume". The module parameter fm_volume sets it at
	  load and at runtime, through
	  /sys/module/snd_es1869/parameters/fm_volume.

config SND_ES1869_DEFAULT_LINE_VOLUME
	int "line_volume"
	range 0 15
	default 0
	help
	  Line in to the output (3Eh), 13 = 0 dB. The ALSA control "Line
	  Playback Volume". The module parameter line_volume sets it at
	  load and at runtime, through
	  /sys/module/snd_es1869/parameters/line_volume.

config SND_ES1869_DEFAULT_CD_VOLUME
	int "cd_volume"
	range 0 15
	default 0
	help
	  AuxA (CD) to the output (38h), 13 = 0 dB. The ALSA control "CD
	  Playback Volume". The module parameter cd_volume sets it at
	  load and at runtime, through
	  /sys/module/snd_es1869/parameters/cd_volume.

config SND_ES1869_DEFAULT_AUX_VOLUME
	int "aux_volume"
	range 0 15
	default 0
	help
	  AuxB to the output (3Ah), 13 = 0 dB. The ALSA control "Aux
	  Playback Volume". The module parameter aux_volume sets it at
	  load and at runtime, through
	  /sys/module/snd_es1869/parameters/aux_volume.

config SND_ES1869_DEFAULT_MIC_VOLUME
	int "mic_volume"
	range 0 15
	default 0
	help
	  The microphone to the output (1Ah), 8 = 0 dB. The ALSA control
	  "Mic Playback Volume". The module parameter mic_volume sets it
	  at load and at runtime, through
	  /sys/module/snd_es1869/parameters/mic_volume.

config SND_ES1869_DEFAULT_MONO_VOLUME
	int "mono_volume"
	range 0 15
	default 0
	help
	  MONO_IN to the output (6Dh), 13 = 0 dB. The ALSA control "Mono
	  Playback Volume". The module parameter mono_volume sets it at
	  load and at runtime, through
	  /sys/module/snd_es1869/parameters/mono_volume.

config SND_ES1869_DEFAULT_BEEP_VOLUME
	int "beep_volume"
	range 0 7
	default 0
	help
	  The PC speaker (3Ch bits 2:0), 7 = -6 dB, 0 mutes it; the
	  board mixes it in after the master, so with beep_follow this
	  is its level at full master. The ALSA control "Beep Playback
	  Volume". The module parameter beep_volume sets it at load and
	  at runtime, through
	  /sys/module/snd_es1869/parameters/beep_volume.

config SND_ES1869_DEFAULT_BEEP_FOLLOW
	int "beep_follow"
	range 0 1
	default 1
	help
	  3Ch scaled by the master and 0 while it is muted, as ESS's
	  ES1869.DRV does it; 0 keeps the two apart. The ALSA control
	  "Beep Follows Master Playback Switch". The module parameter
	  beep_follow sets it at load and at runtime, through
	  /sys/module/snd_es1869/parameters/beep_follow.

config SND_ES1869_DEFAULT_CAPTURE_SOURCE
	int "capture_source"
	range 0 7
	default 5
	help
	  The record source (1Ch bits 2:0): 5 the record mixer, 7 the
	  3-D output before the master. The ALSA control "Capture
	  Source". The module parameter capture_source sets it at load
	  and at runtime, through
	  /sys/module/snd_es1869/parameters/capture_source.

config SND_ES1869_DEFAULT_CAPTURE_VOLUME
	int "capture_volume"
	range 0 15
	default 4
	help
	  The record level (B4h, right in bits 7:4), 1.5 dB a step. The
	  ALSA control "Capture Volume". The module parameter
	  capture_volume sets it at load and at runtime, through
	  /sys/module/snd_es1869/parameters/capture_volume.

config SND_ES1869_DEFAULT_CAPTURE_SWITCH
	int "capture_switch"
	range 0 1
	default 1
	help
	  The record source on (1Ch bit 4 clear). The ALSA control
	  "Capture Switch". The module parameter capture_switch sets it
	  at load and at runtime, through
	  /sys/module/snd_es1869/parameters/capture_switch.

config SND_ES1869_DEFAULT_RECORD_MONITOR
	int "record_monitor"
	range 0 1
	default 0
	help
	  AOUT carries the record source in place of the playback mix
	  while Audio 1 records (A8h bit 3). The ALSA control "Record
	  Monitor". The module parameter record_monitor sets it at load
	  and at runtime, through
	  /sys/module/snd_es1869/parameters/record_monitor.

config SND_ES1869_DEFAULT_A2_CAPTURE
	int "a2_capture"
	range 0 15
	default 0
	help
	  Audio 2 into the record mixer (69h). The ALSA control "PCM
	  Capture Volume". The module parameter a2_capture sets it at
	  load and at runtime, through
	  /sys/module/snd_es1869/parameters/a2_capture.

config SND_ES1869_DEFAULT_MIC_CAPTURE
	int "mic_capture"
	range 0 15
	default 0
	help
	  The microphone into the record mixer (68h). The ALSA control
	  "Mic Capture Volume". The module parameter mic_capture sets it
	  at load and at runtime, through
	  /sys/module/snd_es1869/parameters/mic_capture.

config SND_ES1869_DEFAULT_LINE_CAPTURE
	int "line_capture"
	range 0 15
	default 0
	help
	  Line in into the record mixer (6Eh). The ALSA control "Line
	  Capture Volume". The module parameter line_capture sets it at
	  load and at runtime, through
	  /sys/module/snd_es1869/parameters/line_capture.

config SND_ES1869_DEFAULT_FM_CAPTURE
	int "fm_capture"
	range 0 15
	default 0
	help
	  The music DAC into the record mixer (6Bh). The ALSA control
	  "FM Capture Volume". The module parameter fm_capture sets it
	  at load and at runtime, through
	  /sys/module/snd_es1869/parameters/fm_capture.

config SND_ES1869_DEFAULT_CD_CAPTURE
	int "cd_capture"
	range 0 15
	default 0
	help
	  AuxA (CD) into the record mixer (6Ah). The ALSA control "CD
	  Capture Volume". The module parameter cd_capture sets it at
	  load and at runtime, through
	  /sys/module/snd_es1869/parameters/cd_capture.

config SND_ES1869_DEFAULT_AUX_CAPTURE
	int "aux_capture"
	range 0 15
	default 0
	help
	  AuxB into the record mixer (6Ch). The ALSA control "Aux
	  Capture Volume". The module parameter aux_capture sets it at
	  load and at runtime, through
	  /sys/module/snd_es1869/parameters/aux_capture.

config SND_ES1869_DEFAULT_MONO_CAPTURE
	int "mono_capture"
	range 0 15
	default 0
	help
	  MONO_IN into the record mixer (6Fh). The ALSA control "Mono
	  Capture Volume". The module parameter mono_capture sets it at
	  load and at runtime, through
	  /sys/module/snd_es1869/parameters/mono_capture.

config SND_ES1869_DEFAULT_MIC_BOOST
	int "mic_boost"
	range 0 1
	default 1
	help
	  The microphone's +26 dB preamp (7Dh bit 3), on after a
	  hardware reset. The ALSA control "Mic Boost (+26dB)". The
	  module parameter mic_boost sets it at load and at runtime,
	  through /sys/module/snd_es1869/parameters/mic_boost.

config SND_ES1869_DEFAULT_ADC_OFFSET
	int "adc_offset"
	range -16 15
	default 0
	help
	  The ADC's offsets (BAh/BBh bits 4:0), 64 a step of the 16-bit
	  sample. The ALSA control "Capture DC Offset". The module
	  parameter adc_offset sets it at load and at runtime, through
	  /sys/module/snd_es1869/parameters/adc_offset.

config SND_ES1869_DEFAULT_WAKE_NO_MUTE
	int "wake_no_mute"
	range 0 1
	default 0
	help
	  No 100 ms AOUT mute when the analog section wakes (BAh bit 5).
	  The ALSA control "Analog Wake No Mute Switch". The module
	  parameter wake_no_mute sets it at load and at runtime, through
	  /sys/module/snd_es1869/parameters/wake_no_mute.

config SND_ES1869_DEFAULT_AUDIO2_OVERSAMPLING
	int "audio2_oversampling"
	range 0 1
	default 0
	help
	  Audio 2's 4x oversampling (71h bit 4), which also bypasses its
	  filter. The ALSA control "Audio 2 Oversampling Playback
	  Switch". The module parameter audio2_oversampling sets it at
	  load and at runtime, through
	  /sys/module/snd_es1869/parameters/audio2_oversampling.

config SND_ES1869_DEFAULT_AUDIO2_FILTER
	int "audio2_filter"
	range 0 1
	default 0
	help
	  Audio 2's switched-capacitor filter in use (71h bit 3 clear).
	  The ALSA control "Audio 2 Filter Playback Switch". The module
	  parameter audio2_filter sets it at load and at runtime,
	  through /sys/module/snd_es1869/parameters/audio2_filter.

config SND_ES1869_DEFAULT_AUDIO1_FILTER
	int "audio1_filter"
	range 0 1
	default 0
	help
	  Audio 1's filter in use (71h bit 2 clear), also the ADC's
	  anti-alias filter. The ALSA control "Audio 1 Filter Switch".
	  The module parameter audio1_filter sets it at load and at
	  runtime, through
	  /sys/module/snd_es1869/parameters/audio1_filter.

config SND_ES1869_DEFAULT_AUDIO2_OWN_CLOCK
	int "audio2_own_clock"
	range 0 1
	default 1
	help
	  Audio 2 at its own rate (71h bit 1), else slaved to Audio 1's.
	  The ALSA control "Audio 2 Own Clock Switch". The module
	  parameter audio2_own_clock sets it at load and at runtime,
	  through /sys/module/snd_es1869/parameters/audio2_own_clock.

config SND_ES1869_DEFAULT_AUDIO2_TO_FM
	int "audio2_to_fm"
	range 0 1
	default 0
	help
	  Audio 2 slaved to the FM (71h bit 0): mixed into the music DAC
	  at 49716 Hz, its sides swapped. The ALSA control "Audio 2 To
	  FM Playback Switch". The module parameter audio2_to_fm sets it
	  at load and at runtime, through
	  /sys/module/snd_es1869/parameters/audio2_to_fm.

config SND_ES1869_DEFAULT_VIDEO_SWITCH
	int "video_switch"
	range 0 1
	default 0
	help
	  The music DAC driven by I2S (7Fh bit 0), which silences FM.
	  The ALSA control "Video Playback Switch". The module parameter
	  video_switch sets it at load and at runtime, through
	  /sys/module/snd_es1869/parameters/video_switch.

config SND_ES1869_DEFAULT_ES689
	int "es689"
	range 0 1
	default 1
	help
	  The ES689 wavetable interface (48h bit 4). The ALSA control
	  "ES689 Input Switch". The module parameter es689 sets it at
	  load and at runtime, through
	  /sys/module/snd_es1869/parameters/es689.

config SND_ES1869_DEFAULT_A8_PLAY_BITS
	int "a8_play_bits"
	range 0 244
	default 0
	help
	  A8h's bits beside its channels and monitor in playback: ESS's
	  player keeps 00h. The module parameter a8_play_bits sets it at
	  load and at runtime, through
	  /sys/module/snd_es1869/parameters/a8_play_bits.

config SND_ES1869_DEFAULT_A8_REC_BITS
	int "a8_rec_bits"
	range 0 244
	default 244
	help
	  A8h's bits beside its channels and monitor in a recording:
	  ESS's F4h (F5h/F6h). The module parameter a8_rec_bits sets it
	  at load and at runtime, through
	  /sys/module/snd_es1869/parameters/a8_rec_bits.

config SND_ES1869_DEFAULT_FILTER_CORNER
	int "filter_corner"
	range 100 1000
	default 875
	help
	  The filters' corner below 44.1 kHz, in thousandths of half the
	  rate; ESS's 875. The ALSA control "Filter Corner". The module
	  parameter filter_corner sets it at load and at runtime,
	  through /sys/module/snd_es1869/parameters/filter_corner.

config SND_ES1869_DEFAULT_MONO_OUT
	int "mono_out"
	range 0 3
	default 3
	help
	  What MONO_OUT carries (7Dh bits 2:1); ESS's 3. The ALSA
	  control "Mono Output Source". The module parameter mono_out
	  sets it at load and at runtime, through
	  /sys/module/snd_es1869/parameters/mono_out.

config SND_ES1869_DEFAULT_MONO_IN_DIRECT
	int "mono_in_direct"
	range 0 1
	default 0
	help
	  MONO_IN straight to the output at unity gain (7Dh bit 0). The
	  ALSA control "Mono Input Direct Playback Switch". The module
	  parameter mono_in_direct sets it at load and at runtime,
	  through /sys/module/snd_es1869/parameters/mono_in_direct.

config SND_ES1869_DEFAULT_SPATIAL_SWITCH
	int "spatial_switch"
	range 0 1
	default 0
	help
	  The effect on (50h bits 3:2), out of reset as it turns on. The
	  ALSA control "3D Control - Switch". The module parameter
	  spatial_switch sets it at load and at runtime, through
	  /sys/module/snd_es1869/parameters/spatial_switch.

config SND_ES1869_DEFAULT_SPATIAL_LEVEL
	int "spatial_level"
	range 0 63
	default 0
	help
	  The effect's boost (52h), +16.8 dB near 450 Hz at 63, 0.75 dB
	  a step. The ALSA control "3D Control - Level". The module
	  parameter spatial_level sets it at load and at runtime,
	  through /sys/module/snd_es1869/parameters/spatial_level.

config SND_ES1869_DEFAULT_SPATIAL_MONO
	int "spatial_mono"
	range 0 1
	default 0
	help
	  Stereo made from the mono sum (50h bit 1). The ALSA control
	  "3D Control - Mono Switch". The module parameter spatial_mono
	  sets it at load and at runtime, through
	  /sys/module/snd_es1869/parameters/spatial_mono.

config SND_ES1869_DEFAULT_SPATIAL_LIMIT
	int "spatial_limit"
	range 0 1
	default 0
	help
	  The automatic width limit (50h bit 0). The ALSA control "3D
	  Control - Limit Switch". The module parameter spatial_limit
	  sets it at load and at runtime, through
	  /sys/module/snd_es1869/parameters/spatial_limit.

config SND_ES1869_DEFAULT_SPATIAL_RISE_LEVEL
	int "spatial_rise_level"
	range 0 255
	default 143
	help
	  The limit's rise level (54h); ESS's 8Fh. The ALSA control "3D
	  Control - Limit Rise Level". The module parameter
	  spatial_rise_level sets it at load and at runtime, through
	  /sys/module/snd_es1869/parameters/spatial_rise_level.

config SND_ES1869_DEFAULT_SPATIAL_FALL_LEVEL
	int "spatial_fall_level"
	range 0 255
	default 149
	help
	  The limit's fall level (56h); ESS's 95h. The ALSA control "3D
	  Control - Limit Fall Level". The module parameter
	  spatial_fall_level sets it at load and at runtime, through
	  /sys/module/snd_es1869/parameters/spatial_fall_level.

config SND_ES1869_DEFAULT_SPATIAL_RISE_SPEED
	int "spatial_rise_speed"
	range 0 15
	default 9
	help
	  The limit's rise speed (58h bits 7:4); ESS's 9. The ALSA
	  control "3D Control - Limit Rise Speed". The module parameter
	  spatial_rise_speed sets it at load and at runtime, through
	  /sys/module/snd_es1869/parameters/spatial_rise_speed.

config SND_ES1869_DEFAULT_SPATIAL_FALL_SPEED
	int "spatial_fall_speed"
	range 0 15
	default 4
	help
	  The limit's fall speed (58h bits 3:0); ESS's 4. The ALSA
	  control "3D Control - Limit Fall Speed". The module parameter
	  spatial_fall_speed sets it at load and at runtime, through
	  /sys/module/snd_es1869/parameters/spatial_fall_speed.

config SND_ES1869_DEFAULT_SPATIAL_FIXED_LEVEL
	int "spatial_fixed_level"
	range 0 255
	default 128
	help
	  The limit's fixed level (5Ah); ESS's 80h. The ALSA control "3D
	  Control - Limit Fixed Level". The module parameter
	  spatial_fixed_level sets it at load and at runtime, through
	  /sys/module/snd_es1869/parameters/spatial_fixed_level.

config SND_ES1869_DEFAULT_HWVOL_SPLIT
	int "hwvol_split"
	range 0 1
	default 0
	help
	  The buttons move 61h/63h instead of the master (64h bit 7).
	  The ALSA control "Hardware Master Volume Split". The module
	  parameter hwvol_split sets it at load and at runtime, through
	  /sys/module/snd_es1869/parameters/hwvol_split.

config SND_ES1869_DEFAULT_HWVOL_MODE
	int "hwvol_mode"
	range 0 3
	default 0
	help
	  The buttons' wiring and debounce (64h bits 3:2). The ALSA
	  control "Hardware Volume Mode". The module parameter
	  hwvol_mode sets it at load and at runtime, through
	  /sys/module/snd_es1869/parameters/hwvol_mode.

config SND_ES1869_DEFAULT_HWVOL_COUNT3
	int "hwvol_count3"
	range 0 1
	default 0
	help
	  2.25 dB a push instead of 0.75 dB (64h bit 5). The ALSA
	  control "Hardware Volume Count By 3 Switch". The module
	  parameter hwvol_count3 sets it at load and at runtime, through
	  /sys/module/snd_es1869/parameters/hwvol_count3.

config SND_ES1869_DEFAULT_GPO0
	int "gpo0"
	range 0 1
	default 0
	help
	  The GPO0 pin (Audio_Base+7 bit 0), low after a hardware reset.
	  The ALSA control "GPO0 Switch". The module parameter gpo0 sets
	  it at load and at runtime, through
	  /sys/module/snd_es1869/parameters/gpo0.

config SND_ES1869_DEFAULT_GPO1
	int "gpo1"
	range 0 1
	default 1
	help
	  The GPO1 pin (Audio_Base+7 bit 1), high after a hardware
	  reset. The ALSA control "GPO1 Switch". The module parameter
	  gpo1 sets it at load and at runtime, through
	  /sys/module/snd_es1869/parameters/gpo1.

config SND_ES1869_DEFAULT_SELF_POWER_DOWN
	int "self_power_down"
	range 0 255
	default 0
	help
	  Partly power down after this many 8 s of no access (BDh), 0
	  never. The ALSA control "Self-Timed Power Down". The module
	  parameter self_power_down sets it at load and at runtime,
	  through /sys/module/snd_es1869/parameters/self_power_down.

config SND_ES1869_DEFAULT_GPO_POWER_DOWN
	int "gpo_power_down"
	range 0 255
	default 0
	help
	  The GPOs at power-down (DSP CFh, read with CEh). The ALSA
	  control "GPO Power Down". The module parameter gpo_power_down
	  sets it at load and at runtime, through
	  /sys/module/snd_es1869/parameters/gpo_power_down.

config SND_ES1869_DEFAULT_PWR_SAVE
	int "pwr_save"
	range 0 3600
	default 0
	help
	  Seconds of idleness before a power-down, 0 never. The ALSA
	  control "Power Save Seconds". The module parameter pwr_save
	  sets it at load and at runtime, through
	  /sys/module/snd_es1869/parameters/pwr_save.

config SND_ES1869_DEFAULT_PWR_FULL
	int "pwr_full"
	range 0 1
	default 0
	help
	  Power down fully (the inputs go silent) instead of partly. The
	  ALSA control "Full Power Down Switch". The module parameter
	  pwr_full sets it at load and at runtime, through
	  /sys/module/snd_es1869/parameters/pwr_full.

config SND_ES1869_DEFAULT_DMA_SINGLE
	int "dma_single"
	range 0 1
	default 0
	help
	  Single transfers instead of demand transfers (8237, B9h, 78h).
	  The ALSA control "Single Mode DMA Switch". The module
	  parameter dma_single sets it at load and at runtime, through
	  /sys/module/snd_es1869/parameters/dma_single.

config SND_ES1869_DEFAULT_A1_BURST
	int "a1_burst"
	range 0 2
	default 2
	help
	  Audio 1's demand transfers (B9h); ESS's 2. The ALSA control
	  "Audio 1 DMA Burst". The module parameter a1_burst sets it at
	  load and at runtime, through
	  /sys/module/snd_es1869/parameters/a1_burst.

config SND_ES1869_DEFAULT_A2_BURST
	int "a2_burst"
	range 0 3
	default 2
	help
	  Audio 2's transfers (78h bits 7:6); ESS's demand 4. The ALSA
	  control "Audio 2 DMA Burst". The module parameter a2_burst
	  sets it at load and at runtime, through
	  /sys/module/snd_es1869/parameters/a2_burst.

config SND_ES1869_DEFAULT_PIIX4_TYPE_F
	int "piix4_type_f"
	range 0 1
	default 0
	help
	  1 keeps an Intel PIIX4's Type F DMA timing on Audio 1's
	  channel as the BIOS set it; 0 turns it off, since with it a
	  recording's first transfer hung the Armada. The module
	  parameter piix4_type_f sets it at load and at runtime, through
	  /sys/module/snd_es1869/parameters/piix4_type_f.

config SND_ES1869_DEFAULT_DRQ_LATCH
	int "drq_latch"
	range 0 1
	default 1
	help
	  Each DRQ held until its DACK (card register 25h bit 7). The
	  ALSA control "DRQ Latch Switch". The module parameter
	  drq_latch sets it at load and at runtime, through
	  /sys/module/snd_es1869/parameters/drq_latch.

config SND_ES1869_DEFAULT_A1_SETTLE_US
	int "a1_settle_us"
	range 20 2000
	default 32
	help
	  Audio 1's start held masked at least this long (us). The
	  module parameter a1_settle_us sets it at load and at runtime,
	  through /sys/module/snd_es1869/parameters/a1_settle_us.

config SND_ES1869_DEFAULT_A1_SETTLE_FRAMES
	int "a1_settle_frames"
	range 0 16
	default 2
	help
	  And at least this many sample periods. The module parameter
	  a1_settle_frames sets it at load and at runtime, through
	  /sys/module/snd_es1869/parameters/a1_settle_frames.

config SND_ES1869_DEFAULT_A1_SETTLE_MODE
	int "a1_settle_mode"
	range 0 1
	default 0
	help
	  0 a timer unmasks the channel, 1 the start waits for it. The
	  module parameter a1_settle_mode sets it at load and at
	  runtime, through
	  /sys/module/snd_es1869/parameters/a1_settle_mode.

config SND_ES1869_DEFAULT_A1C_SETTLE_MS
	int "a1c_settle_ms"
	range 0 1000
	default 200
	help
	  How long a recording waits for the ADC's input to settle after
	  the codec turns to it (ms); 0 starts at once, as ESS's drivers
	  do, and the first 100 ms then carry the input's offset
	  decaying. The ALSA control "ADC Settle Milliseconds". The
	  module parameter a1c_settle_ms sets it at load and at runtime,
	  through /sys/module/snd_es1869/parameters/a1c_settle_ms.

config SND_ES1869_DEFAULT_A2_LEAD_MS
	int "a2_lead_ms"
	range 4 500
	default 40
	help
	  How far ahead Audio 2's ring is filled on DMA 5 (ms). The
	  module parameter a2_lead_ms sets it at load and at runtime,
	  through /sys/module/snd_es1869/parameters/a2_lead_ms.

config SND_ES1869_DEFAULT_A2_TICK_US
	int "a2_tick_us"
	range 500 20000
	default 2000
	help
	  The ring's refill period on DMA 5 while a copy is behind (us);
	  under dmix a quarter of a2_lead_ms, if that is longer. The
	  module parameter a2_tick_us sets it at load and at runtime,
	  through /sys/module/snd_es1869/parameters/a2_tick_us.

config SND_ES1869_DEFAULT_A2_PAUSE
	int "a2_pause"
	range 0 1
	default 0
	help
	  Pause on an 8-bit Audio 2 channel through 78h, which may
	  resume off step. The module parameter a2_pause sets it at load
	  and at runtime, through
	  /sys/module/snd_es1869/parameters/a2_pause.

config SND_ES1869_DEFAULT_A2_RESAMPLE
	int "a2_resample"
	range 0 2
	default 2
	help
	  Audio 2's 16-bit streams on DMA 5 through a filter that
	  corrects their rate, also while one plays: Trim by a2_trim,
	  Clock also to the system's clock, as the chip's measures
	  against it, which is true time with chronyd running; Off
	  leaves the samples as they are. The ALSA control "Audio 2 Rate
	  Correction". The module parameter a2_resample sets it at load
	  and at runtime, through
	  /sys/module/snd_es1869/parameters/a2_resample.

config SND_ES1869_DEFAULT_A2_TRIM
	int "a2_trim"
	range 0 24
	default 12
	help
	  What the rate correction adds to the stream's rate. The ALSA
	  control "Audio 2 Rate Trim". The module parameter a2_trim sets
	  it at load and at runtime, through
	  /sys/module/snd_es1869/parameters/a2_trim.

config SND_ES1869_DEFAULT_A2_TRIM_PPB
	int "a2_trim_ppb"
	range -2000000 2000000
	default 0
	help
	  More of the same in ppb, added to a2_trim. The module
	  parameter a2_trim_ppb sets it at load and at runtime, through
	  /sys/module/snd_es1869/parameters/a2_trim_ppb.

config SND_ES1869_DEFAULT_A2_RESAMPLE_DITHER
	int "a2_resample_dither"
	range 0 1
	default 0
	help
	  The rate correction's rounding to 16 bits with triangular
	  noise of 1 LSB: 3 dB more noise for spurs at about -100 dBFS.
	  The ALSA control "Audio 2 Rate Dither Playback Switch". The
	  module parameter a2_resample_dither sets it at load and at
	  runtime, through
	  /sys/module/snd_es1869/parameters/a2_resample_dither.

config SND_ES1869_DEFAULT_A2_OVERSAMPLE
	int "a2_oversample"
	range 0 2
	default 0
	help
	  The DAC clocked at this many times a 16-bit stream's rate on
	  DMA 5 (70h), through the rate filter, where a divisor of the
	  stream's own gives that exactly: no images, less droop, more
	  of the ISA bus and CPU. A playing stream takes it at once,
	  restarting as at a pause. 3x can't run while Audio 1 records.
	  The ALSA control "Audio 2 Output Rate". The module parameter
	  a2_oversample sets it at load and at runtime, through
	  /sys/module/snd_es1869/parameters/a2_oversample.

config SND_ES1869_DEFAULT_A2_TREBLE
	int "a2_treble"
	range 0 1
	default 0
	help
	  Audio 2 through the filter with the DAC's own response taken
	  back, at 1x: flat to 20 kHz within 0.15 dB at 44.1 kHz, with
	  the DAC's stages off, for 4 dB less headroom there. The ALSA
	  control "Audio 2 Treble Correction Playback Switch". The
	  module parameter a2_treble sets it at load and at runtime,
	  through /sys/module/snd_es1869/parameters/a2_treble.

config SND_ES1869_DEFAULT_A1P_MAX_RATE
	int "a1p_max_rate"
	range 3101 793800
	default 48000
	help
	  Audio 1 playback's highest rate (Hz). The module parameter
	  a1p_max_rate sets it at load and at runtime, through
	  /sys/module/snd_es1869/parameters/a1p_max_rate.

config SND_ES1869_DEFAULT_A1C_MAX_RATE
	int "a1c_max_rate"
	range 3101 793800
	default 52920
	help
	  Audio 1 recording's highest rate (Hz): the ADC delivers
	  nothing from 56700. The module parameter a1c_max_rate sets it
	  at load and at runtime, through
	  /sys/module/snd_es1869/parameters/a1c_max_rate.

config SND_ES1869_DEFAULT_A2_MAX_RATE
	int "a2_max_rate"
	range 6000 793800
	default 96000
	help
	  Audio 2's highest rate (Hz): clean to 99225 with Audio 1
	  recording, 132300 alone. The module parameter a2_max_rate sets
	  it at load and at runtime, through
	  /sys/module/snd_es1869/parameters/a2_max_rate.

config SND_ES1869_DEFAULT_A1_MAX_BPS
	int "a1_max_bps"
	range 12404 3175200
	default 211680
	help
	  Audio 1's highest DMA byte rate. The module parameter
	  a1_max_bps sets it at load and at runtime, through
	  /sys/module/snd_es1869/parameters/a1_max_bps.

config SND_ES1869_DEFAULT_A2_MAX_BPS
	int "a2_max_bps"
	range 12404 3175200
	default 384000
	help
	  Audio 2's highest DMA byte rate. The module parameter
	  a2_max_bps sets it at load and at runtime, through
	  /sys/module/snd_es1869/parameters/a2_max_bps.

config SND_ES1869_DEFAULT_RATE_LIMIT
	int "rate_limit"
	range 0 1
	default 1
	help
	  0 lifts the rate limits above, for es1869test's rate.max. The
	  ALSA control "Rate Limit Switch". The module parameter
	  rate_limit sets it at load and at runtime, through
	  /sys/module/snd_es1869/parameters/rate_limit.

config SND_ES1869_DEFAULT_FMDIG_DEVICE
	int "fmdig_device"
	range 0 1
	default 1
	help
	  PCM device 1, the music DAC recorded digitally, opens. The
	  ALSA control "FM Digital Capture Switch". The module parameter
	  fmdig_device sets it at load and at runtime, through
	  /sys/module/snd_es1869/parameters/fmdig_device.

config SND_ES1869_DEFAULT_DUAL_PLAYBACK
	int "dual_playback"
	range 0 1
	default 0
	help
	  PCM device 2, both DACs as four channels, opens. The ALSA
	  control "Dual Playback Switch". The module parameter
	  dual_playback sets it at load and at runtime, through
	  /sys/module/snd_es1869/parameters/dual_playback.

config SND_ES1869_DEFAULT_IRQ_SOURCES
	int "irq_sources"
	range 0 15
	default 15
	help
	  The sources the line carries: 1 Audio 1, 2 Audio 2, 4 the
	  buttons, 8 the MPU-401. The module parameter irq_sources sets
	  it at load and at runtime, through
	  /sys/module/snd_es1869/parameters/irq_sources.

config SND_ES1869_DEFAULT_IRQ_MODE
	int "irq_mode"
	range 0 1
	default 0
	help
	  0 the sources polled where they live, as ESS's drivers do; 1
	  through Config_Base+6/+7. The module parameter irq_mode sets
	  it at load and at runtime, through
	  /sys/module/snd_es1869/parameters/irq_mode.

config SND_ES1869_DEFAULT_IRQ_TRACE
	int "irq_trace"
	range 0 2
	default 0
	help
	  For debugging: 1 logs the streams' steps and each interrupt's
	  sources, 2 also every port write. The module parameter
	  irq_trace sets it at load and at runtime, through
	  /sys/module/snd_es1869/parameters/irq_trace.

config SND_ES1869_DEFAULT_REGS_WRITE
	int "regs_write"
	range 0 1
	default 0
	help
	  The register hwdep writes (CAP_SYS_RAWIO too). The module
	  parameter regs_write sets it at load and at runtime, through
	  /sys/module/snd_es1869/parameters/regs_write.

config SND_ES1869_DEFAULT_OPL3
	int "opl3"
	range 0 1
	default 1
	help
	  The OPL3 hwdep and synth open. The ALSA control "OPL3 Switch".
	  The module parameter opl3 sets it at load and at runtime,
	  through /sys/module/snd_es1869/parameters/opl3.

config SND_ES1869_DEFAULT_ESFM
	int "esfm"
	range 0 1
	default 1
	help
	  The ESFM hwdep and synth open. The ALSA control "ESFM Switch".
	  The module parameter esfm sets it at load and at runtime,
	  through /sys/module/snd_es1869/parameters/esfm.

config SND_ES1869_DEFAULT_FM_SIDES
	int "fm_sides"
	range 0 1
	default 1
	help
	  OPL3 channel A and the ESFM synth's pan left on the left
	  output; 0 the chip's mirror. The ALSA control "FM Sides
	  Switch". The module parameter fm_sides sets it at load and at
	  runtime, through /sys/module/snd_es1869/parameters/fm_sides.

config SND_ES1869_DEFAULT_ESFM_DELAY
	int "esfm_delay"
	range 0 32
	default 6
	help
	  Status reads after each ESFM address or data write. The module
	  parameter esfm_delay sets it at load and at runtime, through
	  /sys/module/snd_es1869/parameters/esfm_delay.

config SND_ES1869_DEFAULT_ESFM_BANK
	string "esfm_bank"
	default "es1869/esfm-gm.bin"
	help
	  The GM bank's firmware file; a write loads it. The module
	  parameter esfm_bank sets it at load and at runtime, through
	  /sys/module/snd_es1869/parameters/esfm_bank.

config SND_ES1869_DEFAULT_ESFM_SQUARE
	int "esfm_square"
	range 0 1
	default 0
	help
	  The bank with the better square wave
	  (es1869/esfm-gm-square.bin). The ALSA control "ESFM Better
	  Square Switch". The module parameter esfm_square sets it at
	  load and at runtime, through
	  /sys/module/snd_es1869/parameters/esfm_square.

config SND_ES1869_DEFAULT_ESFM_SILENCE_ON_CLOSE
	int "esfm_silence_on_close"
	range 0 1
	default 1
	help
	  Every voice off when the synth's last user goes, the pedal's
	  too; 0 is ESS's all notes off, though the FM's return to the
	  OPL3 mode stops them right after. The ALSA control "ESFM
	  Silence On Close Switch". The module parameter
	  esfm_silence_on_close sets it at load and at runtime, through
	  /sys/module/snd_es1869/parameters/esfm_silence_on_close.

config SND_ES1869_DEFAULT_ESFM_PEDAL_RELEASE
	int "esfm_pedal_release"
	range 0 1
	default 1
	help
	  A program change releases the sustain pedal. The ALSA control
	  "ESFM Pedal Release Switch". The module parameter
	  esfm_pedal_release sets it at load and at runtime, through
	  /sys/module/snd_es1869/parameters/esfm_pedal_release.

config SND_ES1869_DEFAULT_ESFM_VIBRATO
	int "esfm_vibrato"
	range 0 1
	default 1
	help
	  Vibrato from the modulation wheel and channel pressure. The
	  ALSA control "ESFM Vibrato Switch". The module parameter
	  esfm_vibrato sets it at load and at runtime, through
	  /sys/module/snd_es1869/parameters/esfm_vibrato.

config SND_ES1869_DEFAULT_ESFM_TUNING
	int "esfm_tuning"
	range 0 1
	default 1
	help
	  RPN 1 and 2, fine and coarse tuning. The ALSA control "ESFM
	  Tuning Switch". The module parameter esfm_tuning sets it at
	  load and at runtime, through
	  /sys/module/snd_es1869/parameters/esfm_tuning.

config SND_ES1869_DEFAULT_ESFM_RESET_CONTROLLERS
	int "esfm_reset_controllers"
	range 0 1
	default 1
	help
	  Controller 121 as RP-015 has it; 0 ESS's reset. The ALSA
	  control "ESFM Reset Controllers Switch". The module parameter
	  esfm_reset_controllers sets it at load and at runtime, through
	  /sys/module/snd_es1869/parameters/esfm_reset_controllers.

config SND_ES1869_DEFAULT_ESFM_LIVE_PAN
	int "esfm_live_pan"
	range 0 1
	default 1
	help
	  A pan change moves sounding notes too. The ALSA control "ESFM
	  Live Pan Switch". The module parameter esfm_live_pan sets it
	  at load and at runtime, through
	  /sys/module/snd_es1869/parameters/esfm_live_pan.

config SND_ES1869_DEFAULT_ESFM_SYSEX
	int "esfm_sysex"
	range 0 1
	default 1
	help
	  The GM, GM2, GS and XG resets and the master volume. The ALSA
	  control "ESFM SysEx Switch". The module parameter esfm_sysex
	  sets it at load and at runtime, through
	  /sys/module/snd_es1869/parameters/esfm_sysex.

endmenu
```
